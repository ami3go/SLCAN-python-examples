VERSION ""

NS_ :

BS_:

BU_:

BO_ 1024 EMV_Pegel: 4 Vector__XXX
 SG_ EMV_Pegel : 0|32@1- (1,0) [0|0] "A od. V/m" Vector__XXX

BO_ 768 EMV_Frequenz: 4 Vector__XXX
 SG_ EMV_Frequenz : 0|32@1- (1E-006,0) [0|0] "MHz" Vector__XXX

BA_DEF_  "BusType" STRING ;
BA_DEF_DEF_  "BusType" "CAN";
SIG_VALTYPE_ 1024 EMV_Pegel : 1;
SIG_VALTYPE_ 768 EMV_Frequenz : 1;
